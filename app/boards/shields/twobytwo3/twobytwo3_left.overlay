
#include "twobytwo3.dtsi" // Notice that the main dtsi files are included in the overlay.

&kscan0 {
  col-gpios
    = <&pro_micro 16 (GPIO_ACTIVE_HIGH | GPIO_PULL_DOWN)>
    , <&pro_micro 10 (GPIO_ACTIVE_HIGH | GPIO_PULL_DOWN)>
    ;
};
