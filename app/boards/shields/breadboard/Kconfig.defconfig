## app/boards/shields/breadboard/Kconfig.defconfig
```kconfig
if SHIELD_BREADBOARD_RIGHT

config ZMK_KEYBOARD_NAME
  default "Breadboard"

config ZMK_SPLIT_ROLE_CENTRAL
  default y

endif

if SHIELD_BREADBOARD_RIGHT || SHIELD_BREADBOARD_LEFT

config ZMK_SPLIT
  default y

endif
```

## app/boards/shields/breadboard/Kconfig.shield
```kconfig
#
# Configuration that defines the shield.
#

config SHIELD_BREADBOARD
  def_bool $(shields_list_contains,breadboard)

config SHIELD_BREADBOARD_LEFT
  def_bool $(shields_list_contains,breadboard_left)

config SHIELD_BREADBOARD_RIGHT
  def_bool $(shields_list_contains,breadboard_right)

#
# End of file.
#
```

## app/boards/shields/twobytwo2/Kconfig.defconfig
```kconfig
if SHIELD_TWOBYTWO2_RIGHT

config ZMK_KEYBOARD_NAME
    default "Two By Two"

config ZMK_SPLIT_ROLE_CENTRAL
        default y

endif

if SHIELD_TWOBYTWO2_RIGHT || SHIELD_TWOBYTWO2_LEFT

config ZMK_SPLIT
    default y

endif
```

## app/boards/shields/twobytwo2/Kconfig.shield
```kconfig
#
# Configuration that defines the shield.
#

config SHIELD_TWOBYTWO2
  def_bool $(shields_list_contains,twobytwo2)

config SHIELD_TWOBYTWO2_LEFT
  def_bool $(shields_list_contains,twobytwo2_left)

config SHIELD_TWOBYTWO2_RIGHT
  def_bool $(shields_list_contains,twobytwo2_right)

#
# End of file.
#
```

## app/boards/shields/twobytwo3/Kconfig.defconfig
```kconfig
if SHIELD_TWOBYTWO3_RIGHT

config ZMK_KEYBOARD_NAME
  default "Two By Two"

config ZMK_SPLIT_ROLE_CENTRAL
  default y

endif

if SHIELD_TWOBYTWO3_RIGHT || SHIELD_TWOBYTWO3_LEFT

config ZMK_SPLIT
  default y

config I2C
  default y

endif
```

## app/boards/shields/twobytwo3/Kconfig.shield
```kconfig
#
# Configuration that defines the shield.
#

config SHIELD_TWOBYTWO3
  def_bool $(shields_list_contains,twobytwo3)

config SHIELD_TWOBYTWO3_LEFT
  def_bool $(shields_list_contains,twobytwo3_left)

config SHIELD_TWOBYTWO3_RIGHT
  def_bool $(shields_list_contains,twobytwo3_right)

#
# End of file.
#
```

## app/boards/shields/twobytwo4/Kconfig.shield
```kconfig
#
# Configuration that defines the shield.
#

config SHIELD_TWOBYTWO4
  def_bool $(shields_list_contains,twobytwo4)

config SHIELD_TWOBYTWO4_LEFT
  def_bool $(shields_list_contains,twobytwo4_left)

config SHIELD_TWOBYTWO4_RIGHT
  def_bool $(shields_list_contains,twobytwo4_right)

#
# End of file.
#
```

## app/boards/shields/twobytwo5/Kconfig.defconfig
```kconfig
if SHIELD_TWOBYTWO5_RIGHT

config ZMK_KEYBOARD_NAME
    default "Two By Two"

config ZMK_SPLIT_ROLE_CENTRAL
        default y

endif

if SHIELD_TWOBYTWO5_RIGHT || SHIELD_TWOBYTWO5_LEFT

config ZMK_SPLIT
    default y

endif
```

## app/boards/shields/twobytwo5/Kconfig.shield
```kconfig
#
# Configuration that defines the shield.
#

config SHIELD_TWOBYTWO5
  def_bool $(shields_list_contains,twobytwo5)

config SHIELD_TWOBYTWO5_LEFT
  def_bool $(shields_list_contains,twobytwo5_left)

config SHIELD_TWOBYTWO5_RIGHT
  def_bool $(shields_list_contains,twobytwo5_right)

#
# End of file.
#
```

## app/boards/shields/yackboard-v1/Kconfig.defconfig
```kconfig
if SHIELD_YACKBOARD_RIGHT

config ZMK_KEYBOARD_NAME
  default "Yackboard"

config ZMK_SPLIT_ROLE_CENTRAL
  default y

endif

if SHIELD_YACKBOARD_RIGHT || SHIELD_YACKBOARD_LEFT

config ZMK_SPLIT
  default y

config I2C
  default y

endif
```

## app/boards/shields/yackboard-v1/Kconfig.shield
```kconfig
#
# Configuration that defines the shield.
#

config SHIELD_YACKBOARD
  def_bool $(shields_list_contains,yackboard-v1)

config SHIELD_YACKBOARD_LEFT
  def_bool $(shields_list_contains,yackboard-v1_left)

config SHIELD_YACKBOARD_RIGHT
  def_bool $(shields_list_contains,yackboard-v1_right)

#
# End of file.
#
```

## app/dts/bindings/behaviors/zmk,behavior-antecedent-morph.yaml
```yaml
# Copyright (c) 2023 The ZMK Contributors
# SPDX-License-Identifier: MIT

description: Antecedent Morph Behavior

compatible: "zmk,behavior-antecedent-morph"

include: zero_param.yaml

properties:
  bindings:
    type: phandle-array
    required: true
  antecedents:
    type: array
    required: true
  max-delay-ms:
    type: int
    default: -1
```

## app/module/dts/bindings/sensor/pimoroni,trackball_pim447.yaml
```yaml
# Copyright (c) 2021 The ZMK Contributors
# SPDX-License-Identifier: MIT

description: Trackball PIM447

compatible: "pimoroni,trackball_pim447"

properties:
  label:
    type: string
    required: true

  reg:
    type: int
    required: true

  move-factor-x:
    type: int
    required: false
    default: 100

  move-factor-y:
    type: int
    required: false
    default: 100

  move-inertia-x:
    type: int
    required: false
    default: 0

  move-inertia-y:
    type: int
    required: false
    default: 0

  invert-move-x:
    type: boolean
    required: false

  invert-move-y:
    type: boolean
    required: false

  button:
    type: int
    required: false
    default: 0

  swap-axes:
    type: boolean
    required: false

  poll-interval:
    type: int
    required: false
    default: 50

  scroll-divisor-x:
    type: int
    required: false
    default: 2

  scroll-divisor-y:
    type: int
    required: false
    default: 2

  invert-scroll-x:
    type: boolean
    required: false

  invert-scroll-y:
    type: boolean
    required: false

  mode:
    type: int
    required: false
    default: 1
    enum:
      - 1
      - 2
      - 3

  norm:
    type: int
    required: false
    default: 1
    enum:
      - 1
      - 2

  exactness:
    type: int
    required: false
    default: 4

  max-accel:
    type: int
    required: false
    default: 100
```
